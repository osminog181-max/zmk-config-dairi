## boards/shields/3x10/Kconfig.defconfig
```kconfig
if SHIELD_3X10

config ZMK_KEYBOARD_NAME
    default "3x10"

config ZMK_SPLIT
	default y

config ZMK_BLE
	default y

endif

if SHIELD_DONGLE

config ZMK_KEYBOARD_NAME
	default "dongle"
	
config ZMK_SPLIT_BLE_ROLE_CENTRAL
	default y
	
config ZMK_USB
	default y

endif
```

## boards/shields/3x10/Kconfig.shield
```kconfig
config SHIELD_3X10
    def_bool $(shields_list_contains,3x10)
config SHIELD_DONGLE
	def_bool $(shields_list_contains,dongle)
```

## boards/shields/dairi /Kconfig.defconfig
```kconfig
# Copyright (c) 2020 The ZMK Contributors
# SPDX-License-Identifier: MIT

if SHIELD_DONGLE

config ZMK_KEYBOARD_NAME
	default "dongle"
	
config ZMK_SPLIT_BLE_ROLE_CENTRAL
	default y
	
config ZMK_USB
	default y

endif

if SHIELD_DAIRI

config ZMK_SPLIT
	default y

config ZMK_BLE
	default y
	
endif
```

## boards/shields/dairi /Kconfig.shield
```kconfig
# Copyright (c) 2020 The ZMK Contributors
# SPDX-License-Identifier: MIT

config SHIELD_DAIRI
    def_bool $(shields_list_contains,dairi)
config SHIELD_DONGLE
    def_bool $(shields_list_contains,dongle)
```

## boards/shields/dongle/Kconfig.shield
```kconfig
config SHIELD_DONGLE
    def_bool y

config ZMK_KEYBOARD_NAME
    default "3x10"
```
