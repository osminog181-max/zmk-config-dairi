#include <dt-bindings/zmk/matrix_transform.h>

/ {
    chosen {
        zmk,kscan = &mock_kscan;
    };

    mock_kscan: mock_kscan_0 {
        compatible = "zmk,kscan-mock";
        columns = <10>;     # ← важно! должно соответствовать клавиатуре
        rows = <4>;         # ← важно!
    };
};
